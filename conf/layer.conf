## conf/layer.conf
```bitbake
# We have a conf and classes directory, add to BBPATH
BBPATH .= ":${LAYERDIR}"

# We have recipes-* directories, add to BBFILES
BBFILES += "${LAYERDIR}/recipes-*/*/*.bb \
            ${LAYERDIR}/recipes-*/*/*.bbappend"

BBFILE_COLLECTIONS += "entropy"
BBFILE_PATTERN_entropy = "^${LAYERDIR}/"
BBFILE_PRIORITY_entropy = "30"
LAYERVERSION_entropy = "4"
LAYERSERIES_COMPAT_entropy = "scarthgap"
```
